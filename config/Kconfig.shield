## config/Kconfig.shield
```kconfig
config SHIELD_SUITE61
    def_bool $(shields_list_contains,suite61)

config SHIELD_SUITE61_LEFT
    def_bool $(shields_list_contains,suite61_left)

config SHIELD_SUITE61_RIGHT
    def_bool $(shields_list_contains,suite61_right)
```

## config/boards/shields/suite61/Kconfig.defconfig
```kconfig
if SHIELD_SUITE61_LEFT

config ZMK_KEYBOARD_NAME
    defalt "Suite61"

config ZMK_SPLIT_ROLE_CENTRAL
    default y

endif

if SHIELD_SUITE61_LEFT || SHIELD_SUITE61_RIGHT

config ZMK_SPLIT 
    default y

endif
```
