// suite61_right.overlay

#include "suite61.dtsi"

&default_transform {
    col-offset = <6>;
};

&right_encoder {
    status = "okay";
};

nice_view_spi: &spi0 {
    compatible = "nordic,nrf-spim";
    sck-pin = <&pro_micro 20>
    mosi-pin = <&pro_micro 17>
    miso-pin = <&gpio0 25>
    cs-gpios = <&gpio0 08 GPIO_ACTIVE_HIGH>
}
